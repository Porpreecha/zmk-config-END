/dts-v1/;
/ {
    compatible = "zmk,keyboard-shield";
    model = "My 6x15 Keyboard";

    chosen {
        zmk,kscan = &kscan0;
        zmk,matrix-transform = &transform0;
    };

    kscan0: kscan {
        compatible = "zmk,kscan-gpio-matrix";
        row-gpios = <&gpio0 0 GPIO_ACTIVE_HIGH>,
                    <&gpio0 1 GPIO_ACTIVE_HIGH>,
                    <&gpio0 2 GPIO_ACTIVE_HIGH>,
                    <&gpio0 3 GPIO_ACTIVE_HIGH>,
                    <&gpio0 4 GPIO_ACTIVE_HIGH>,
                    <&gpio0 5 GPIO_ACTIVE_HIGH>;
        col-gpios = <&gpio1 0 GPIO_ACTIVE_HIGH>,
                    <&gpio1 1 GPIO_ACTIVE_HIGH>,
                    <&gpio1 2 GPIO_ACTIVE_HIGH>,
                    <&gpio1 3 GPIO_ACTIVE_HIGH>,
                    <&gpio1 4 GPIO_ACTIVE_HIGH>,
                    <&gpio1 5 GPIO_ACTIVE_HIGH>,
                    <&gpio1 6 GPIO_ACTIVE_HIGH>,
                    <&gpio1 7 GPIO_ACTIVE_HIGH>,
                    <&gpio1 8 GPIO_ACTIVE_HIGH>,
                    <&gpio1 9 GPIO_ACTIVE_HIGH>,
                    <&gpio1 10 GPIO_ACTIVE_HIGH>,
                    <&gpio1 11 GPIO_ACTIVE_HIGH>,
                    <&gpio1 12 GPIO_ACTIVE_HIGH>,
                    <&gpio1 13 GPIO_ACTIVE_HIGH>,
                    <&gpio1 14 GPIO_ACTIVE_HIGH>;
    };

    transform0: keymap_transform {
        compatible = "zmk,matrix-transform";
        rows = <6>;
        cols = <15>;
    };
};
